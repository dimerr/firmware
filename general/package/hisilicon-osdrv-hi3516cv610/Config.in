## general/package/hisilicon-osdrv-hi3516cv610/Config.in
```kconfig
config BR2_PACKAGE_HISILICON_OSDRV_HI3516CV610
	bool "hisilicon-osdrv-hi3516cv610"
	help
	  hisilicon-osdrv-hi3516cv610 - Hisilicon kernel modules
	  and libs.

	  https://openipc.org
```
